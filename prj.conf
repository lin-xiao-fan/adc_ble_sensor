## CMakeLists.txt
```
# SPDX-License-Identifier: Apache-2.0

cmake_minimum_required(VERSION 3.20.0)
find_package(Zephyr REQUIRED HINTS $ENV{ZEPHYR_BASE})
project(blinky)

target_sources(app PRIVATE
  src/main.c
  src/ble_service.c
  src/adc_sensor.c
)
```

## prj.conf
```kconfig
#prj.conf
# 啟用藍牙功能
CONFIG_BT=y         

# 設定裝置為藍牙周邊裝置 (Peripheral)          
CONFIG_BT_PERIPHERAL=y       

# 設定藍牙裝置名稱為 "XXX BLE"
CONFIG_BT_DEVICE_NAME="GSI BLE"  

# 設定裝置外觀 (Appearance)，0表示預設
CONFIG_BT_DEVICE_APPEARANCE=0    

# 關閉系統日誌功能，減少資源佔用
CONFIG_LOG=n                    

# 設定最多允許1個藍牙連線
CONFIG_BT_MAX_CONN=1             

# 啟用ADC功能
CONFIG_ADC=y                     

# 啟用nRF5x系列的SAADC ADC驅動，假設你用的是nRF52系列
CONFIG_ADC_NRFX_SAADC=y          
```

## src/main.c
```c
//main.c
#include <zephyr/kernel.h>    // Zephyr 核心功能，如延遲等
#include "adc_sensor.h"       // ADC 感測器相關函式宣告
#include "ble_service.h"      // BLE 通訊相關函式宣告

int main(void)
{
    // 初始化 ADC 感測器硬體與設定
    adc_sensor_init();

    // 初始化 BLE 通訊模組，準備連線與資料傳輸
    ble_init();

    // 建立一個長度為6的陣列，用來存放要傳送的資料封包
	uint8_t packet[6] = {0};

    // 主迴圈，持續執行以下動作
    while (1) {
        // 如果有偵測到按鈕觸發，會將事件資料寫入 packet 陣列並回傳 true
        //if ( adc_check_toy(packet)) { // 玩具的韌體用這行
        //if ( adc_check_tv(packet)) { // TV的韌體用這行
        if ( adc_check_gsi(packet)) { // 儀器的韌體用這行

            // 有新事件觸發，透過 BLE 傳送通知封包給連線裝置
            ble_send_notify_packet(packet, sizeof(packet));

            
        }
        // 休息 100 毫秒，避免過度輪詢導致資源浪費
        k_msleep(100);
    }
}
```

## src/adc_sensor.c
```c
// adc_sensor.c
#include "adc_sensor.h"
#include "ble_service.h"
#include <zephyr/device.h>
#include <zephyr/drivers/adc.h>
#include <zephyr/sys/printk.h>
#include <hal/nrf_saadc.h>
#include <zephyr/sys/util.h>
#include <zephyr/kernel.h>  // for k_uptime_get()

// 常數定義
#define PRESSURE_THRESHOLD   250       // 玩具按鈕壓力閾值
#define TV_THRESHOLD         400       // TV按鈕壓力閾值（較高）
#define DEBOUNCE_INTERVAL_MS 1500      // 去彈跳時間(毫秒)，避免重複觸發
#define ADC_RESOLUTION       12        // ADC解析度 12 bit
#define ADC_GAIN             ADC_GAIN_1
#define ADC_REFERENCE        ADC_REF_INTERNAL
#define ADC_ACQUISITION      ADC_ACQ_TIME_DEFAULT
#define PACKET_SIZE          6
#define ADC_CHANNEL_COUNT    8         // ADC通道數量

// 取得 ADC 裝置物件指標
static const struct device *adc_dev = DEVICE_DT_GET(DT_NODELABEL(adc));

// 宣告ADC讀取的資料暫存區陣列，每個通道一個
static int16_t sample_buffers[ADC_CHANNEL_COUNT];

// ADC 通道設定結構陣列
static struct adc_channel_cfg adc_cfgs[ADC_CHANNEL_COUNT];

// ADC 讀取序列結構陣列
static struct adc_sequence adc_sequences[ADC_CHANNEL_COUNT];

// ADC 對應的硬體腳位 (nRF SAADC輸入腳位)                           三個裝置的不同按鈕對應的腳位
static const nrf_saadc_input_t adc_inputs[ADC_CHANNEL_COUNT] = {
    NRF_SAADC_INPUT_AIN0, // channel 0: P0.02 (玩具按鈕 ToyRF_ON ) (TV 按鈕 TV_left ) 
    NRF_SAADC_INPUT_AIN1, // channel 1: P0.03 (玩具按鈕 ToyRF_OFF) (TV 按鈕 TV_right) 
    NRF_SAADC_INPUT_AIN7, // channel 2: P0.31 (玩具按鈕 ToyRS_ON )                    (GSI儀器按鈕 channel1)
    NRF_SAADC_INPUT_AIN6, // channel 3: P0.30 (玩具按鈕 ToyRS_OFF)                    (GSI儀器按鈕 left)
    NRF_SAADC_INPUT_AIN5, // channel 4: P0.29 (玩具按鈕 ToyLF_ON )                    (GSI儀器按鈕 right)
    NRF_SAADC_INPUT_AIN4, // channel 5: P0.28 (玩具按鈕 ToyLF_OFF)                    (GSI儀器按鈕 left&right)
    NRF_SAADC_INPUT_AIN3, // channel 6: P0.05 (玩具按鈕 ToyLS_ON )
    NRF_SAADC_INPUT_AIN2  // channel 7: P0.04 (玩具按鈕 ToyLS_OFF)
};

// 紀錄 TV 按鈕(4與5)是否處於按下狀態，避免連續重複觸發
static bool tv_pressed[2] = { false, false };  // [0] 對應按鈕tv_left，[1] 對應按鈕tv_right

// 紀錄上一次觸發時間(毫秒)，用於去彈跳判斷
static uint32_t last_trigger_time = 0;

// 初始化 ADC，設定每個通道的參數並註冊
void adc_sensor_init(void) {
    // 確認 ADC 裝置是否準備好
    if (!device_is_ready(adc_dev)) {
        printk("ADC device not ready!\n");
        return;
    }

    // 逐一設定 ADC 通道
    for (int i = 0; i < ADC_CHANNEL_COUNT; ++i) {
        adc_cfgs[i] = (struct adc_channel_cfg){
            .gain             = ADC_GAIN,
            .reference        = ADC_REFERENCE,
            .acquisition_time = ADC_ACQUISITION,
            .channel_id       = i,
            .input_positive   = adc_inputs[i],
        };

        // 註冊此通道設定到 ADC 裝置
        if (adc_channel_setup(adc_dev, &adc_cfgs[i]) != 0) {
            printk("Failed to set up ADC channel %d\n", i);
            return;
        }

        // 設定 ADC 讀取序列的緩衝區與解析度
        adc_sequences[i] = (struct adc_sequence){
            .channels    = BIT(i),
            .buffer      = &sample_buffers[i],
            .buffer_size = sizeof(sample_buffers[i]),
            .resolution  = ADC_RESOLUTION,
        };

        printk("ADC initialized on channel %d\n", i);
    }
}

// 偵測是否有按鈕被按下或放開，並組成資料封包
bool adc_sensor_check_trigger(uint8_t *packet) {
    int pressed = -1;            // 紀錄哪個按鈕被觸發，-1表示沒觸發
    bool is_tv_release = false;  // TV 按鈕是否是放開狀態
    uint32_t now = ble_get_time_since_connected();  // 取得目前連線後的時間（毫秒）

    // 逐通道讀取 ADC 數值並判斷
    for (int i = 0; i < ADC_CHANNEL_COUNT; ++i) {
        // 讀取 ADC 數值，失敗就跳過該通道
        if (adc_read(adc_dev, &adc_sequences[i]) != 0) continue;

        int16_t value = sample_buffers[i];

        // 前4個通道為玩具按鈕，只要超過壓力閾值就判定為按下
        if (i < 6 && value > PRESSURE_THRESHOLD) {
            pressed = i;
            break;
        }

        // 通道4與5是 TV 按鈕，有按下與放開狀態判斷
        if (i == 4 || i == 5) {
            int idx = i - 4;  // tv_pressed陣列索引
            if (value > TV_THRESHOLD) {
                // 按鈕目前沒被按下，改為按下，紀錄觸發
                if (!tv_pressed[idx]) {
                    pressed = i;
                    tv_pressed[idx] = true;
                }
            } else {
                // 按鈕之前是按下，現在壓力低於閾值，判定為放開
                if (tv_pressed[idx]) {
                    pressed = i;
                    is_tv_release = true;
                    tv_pressed[idx] = false;
                }
            }
        }
    }

    // 沒有任何按鈕被觸發，回傳 false
    if (pressed < 0) return false;

    // 判斷是否在去彈跳時間內，避免重複觸發
    if (now - last_trigger_time < DEBOUNCE_INTERVAL_MS) return false;

    // 更新最後觸發時間
    last_trigger_time = now;

    // 組成 BLE 傳送的資料封包
    packet[0] = (now >> 16) & 0xFF;     // 事件時間高位
    packet[1] = (now >> 8) & 0xFF;      // 事件時間中位
    packet[2] = now & 0xFF;             // 事件時間低位
    packet[3] = (uint8_t)pressed;       // 按鈕編號
    packet[4] = 0x01;                   // toy = 0, GSI = 1 (目前固定0)
    // 第5格表示 按鈕開關狀態：0=關，1=開（非放開狀態才是開）

    packet[5] = 0x01 ;

    

    return true;
}



bool adc_check_toy(uint8_t *packet) {
    uint32_t now = ble_get_time_since_connected();

    for (int i = 0; i < 8; ++i) {
        if (adc_read(adc_dev, &adc_sequences[i]) != 0) continue;

        int16_t value = sample_buffers[i];
        if (value > PRESSURE_THRESHOLD) {
            if (now - last_trigger_time < DEBOUNCE_INTERVAL_MS) return false;

            last_trigger_time = now;
            //前三位元是時間
            packet[0] = (now >> 16) & 0xFF;
            packet[1] = (now >> 8) & 0xFF;
            packet[2] = now & 0xFF;
            //第四個位元是裝置編號 toy = 0 , tv = 1 , gsi = 2 
            packet[3] = 0x00;        // toy 裝置
            //第五個位元是按鈕編號 玩具部分有4組 ToyRS = 0 ,ToyRF = 1 ,ToyLS = 2 ,ToyLF = 3
            packet[4] = i/2 ;        // 按鈕四組 0-1, 2-3, 4-5, 6-7 每兩個是一組，所以使用/2來區分
            //第六個位元是開關編號  0 = off, 1 = on
            packet[5] = 1 - ( i%2 ); // 依照順序應該是 on off on off ... 所以1-(2餘數) 可以得出 1 0 1 0 ...的結果

            return true;
        }
    }

    return false;
}


bool adc_check_tv(uint8_t *packet) {
    uint32_t now = ble_get_time_since_connected();

    for (int i = 0; i <= 1; ++i) {
        if (adc_read(adc_dev, &adc_sequences[i]) != 0) continue;

        int16_t value = sample_buffers[i];
        int group = i ;  // 0 or 1

        if (value > TV_THRESHOLD) {
            // 按鈕從未按下狀態 → 按下
            if (!tv_pressed[group]) {
                if (now - last_trigger_time < DEBOUNCE_INTERVAL_MS) return false;
                last_trigger_time = now;

                tv_pressed[group] = true;

                packet[0] = (now >> 16) & 0xFF;
                packet[1] = (now >> 8) & 0xFF;
                packet[2] = now & 0xFF;
                packet[3] = 0x01;      // TV 裝置代號
                packet[4] = group;     // 0 or 1
                packet[5] = 0x01;      // on

                return true;
            }
        } else {
            // 按鈕從按下狀態 → 放開
            if (tv_pressed[group]) {
                if (now - last_trigger_time < DEBOUNCE_INTERVAL_MS) return false;
                last_trigger_time = now;

                tv_pressed[group] = false;

                packet[0] = (now >> 16) & 0xFF;
                packet[1] = (now >> 8) & 0xFF;
                packet[2] = now & 0xFF;
                packet[3] = 0x01;      // TV 裝置代號
                packet[4] = group;     // 0 or 1
                packet[5] = 0x00;      // off

                return true;
            }
        }
    }

    return false;
}


bool adc_check_gsi(uint8_t *packet) {
    uint32_t now = ble_get_time_since_connected();

    for (int i = 2; i <= 5; ++i) {
        if (adc_read(adc_dev, &adc_sequences[i]) != 0) continue;

        int16_t value = sample_buffers[i];
        if (value > PRESSURE_THRESHOLD) {
            if (now - last_trigger_time < DEBOUNCE_INTERVAL_MS) return false;

            last_trigger_time = now;
            //前三位元是時間
            packet[0] = (now >> 16) & 0xFF;
            packet[1] = (now >> 8) & 0xFF;
            packet[2] = now & 0xFF;
            //第四個位元是裝置編號 toy = 0 , tv = 1 , gsi = 2 
            packet[3] = 0x02;        // gsi 裝置
            //第五個位元是按鈕編號 gsi部分有4組 channel1 = 0 ,left = 1 ,right = 2 ,left&right = 3
            packet[4] = i-2 ;        // 按鈕編號
            //第六個位元是開關編號  0 = off, 1 = on
            packet[5] = 0x00; // GSI 開關目前無意義

            return true;
        }
    }

    return false;
}




// 讀取指定感測器 ADC 數值
int16_t adc_sensor_get_value(int sensor_id) {
    // 檢查索引有效性
    if (sensor_id < 0 || sensor_id >= ADC_CHANNEL_COUNT) return -1;

    // 讀取 ADC，失敗回傳 -1
    if (adc_read(adc_dev, &adc_sequences[sensor_id]) != 0) {
        printk("ADC read error (channel %d)\n", sensor_id);
        return -1;
    }

    // 回傳該通道的最新 ADC 數值
    return sample_buffers[sensor_id];
}
```

## src/adc_sensor.h
```c
#pragma once
// 防止此檔案被重複包含，多次包含只會處理一次

#include <zephyr/kernel.h>  // Zephyr核心函式庫，可能用到基礎資料型別與API

// 初始化 ADC 感測器，設定 ADC 硬體與通道
void adc_sensor_init(void);

// 檢查是否有按鈕被觸發
// 如果有觸發事件，會將事件資訊寫入 packet 陣列中，回傳 true
// 沒有事件時回傳 false
bool adc_sensor_check_trigger(uint8_t *packet);
bool adc_check_toy(uint8_t *packet);
bool adc_check_tv(uint8_t *packet);
bool adc_check_gsi(uint8_t *packet);
// 取得指定 sensor (通道) 的 ADC 數值
// sensor_id 範圍為 0 ~ 5（目前6個通道）
// 失敗時回傳 -1
int16_t adc_sensor_get_value(int sensor_id);
```

## src/ble_service.c
```c
//ble_service.c
#include <zephyr/kernel.h>                    // Zephyr核心API，k_uptime_get()等
#include <zephyr/bluetooth/bluetooth.h>      // 藍牙核心API
#include <zephyr/bluetooth/hci.h>            // 藍牙控制器介面
#include <zephyr/bluetooth/gatt.h>           // GATT 服務與特徵相關API
#include "ble_service.h"                      // 對應的 header

static struct bt_conn *current_conn;         // 紀錄目前連線物件
static uint8_t notify_value = 0;              // 通知特徵值，這裡用簡單數值
static uint32_t bt_conn_start_time = 0;      // 紀錄連線開始的系統時間（ms）

// 自訂128-bit UUID，用來定義服務ID (Service UUID)
static struct bt_uuid_128 service_uuid = BT_UUID_INIT_128(
    BT_UUID_128_ENCODE(0x12345678, 0x1234, 0x1234, 0x1234, 0x1234567890ab));

// 自訂128-bit UUID，用來定義特徵ID (Characteristic UUID)
static struct bt_uuid_128 char_uuid = BT_UUID_INIT_128(
    BT_UUID_128_ENCODE(0xabcdef01, 0x1234, 0x5678, 0x9abc, 0xdef012345678));

// CCC（Client Characteristic Configuration）變更回調函式
// 用來偵測中央設備是否開啟通知（Notify）
static void ccc_cfg_changed(const struct bt_gatt_attr *attr, uint16_t value)
{
    // 如果中央設備啟用通知且目前有連線
    if (value == BT_GATT_CCC_NOTIFY && current_conn) {
        // 發送一次通知給中央設備，內容為 notify_value
        bt_gatt_notify(current_conn, attr, &notify_value, sizeof(notify_value));
    }
}

// 定義 GATT 服務及特徵
BT_GATT_SERVICE_DEFINE(simple_svc,
    BT_GATT_PRIMARY_SERVICE(&service_uuid),  // 主要服務
    BT_GATT_CHARACTERISTIC(&char_uuid.uuid,  // 服務裡的特徵，支持通知
                           BT_GATT_CHRC_NOTIFY,
                           BT_GATT_PERM_NONE,
                           NULL, NULL, &notify_value),
    BT_GATT_CCC(ccc_cfg_changed, BT_GATT_PERM_READ | BT_GATT_PERM_WRITE),  // 註冊通知設定的回調
);

// 連線事件回調，連線成功時觸發
static void connected(struct bt_conn *conn, uint8_t err)
{
    if (!err) {
        current_conn = bt_conn_ref(conn);    // 取得連線引用，保留連線物件
        bt_conn_start_time = k_uptime_get(); // 紀錄連線時的系統時間（毫秒）
    }
}

// 斷線事件回調
static void disconnected(struct bt_conn *conn, uint8_t reason)
{
    if (current_conn) {
        bt_conn_unref(current_conn);         // 釋放連線物件
        current_conn = NULL;
    }
}

// 註冊連線與斷線的callback結構
static struct bt_conn_cb conn_callbacks = {
    .connected = connected,
    .disconnected = disconnected,
};

// 初始化 BLE 功能
void ble_init(void)
{
    bt_enable(NULL);                         // 啟用藍牙協定棧

    bt_conn_cb_register(&conn_callbacks);   // 註冊連線回調

    // 廣播資料 (Advertising data)
    const struct bt_data ad[] = {
        BT_DATA_BYTES(BT_DATA_FLAGS, (BT_LE_AD_GENERAL | BT_LE_AD_NO_BREDR)), // 一般廣播，不支援經典藍牙
    };

    // 開始廣播，使用名稱與上述廣播資料
    bt_le_adv_start(BT_LE_ADV_CONN_NAME, ad, ARRAY_SIZE(ad), NULL, 0);
}

// 取得從連線開始到目前的經過時間(ms)
// 如果沒有連線則回傳0
uint32_t ble_get_time_since_connected(void)
{
    if (!current_conn) {
        return 0;
    }
    return k_uptime_get() - bt_conn_start_time;
}

// 傳送通知封包給目前連線的中央設備
void ble_send_notify_packet(uint8_t *data, size_t len)
{
    if (current_conn) {
        // 傳送通知給服務中索引為1的屬性 (即特徵值)
        bt_gatt_notify(current_conn, &simple_svc.attrs[1], data, len);
    }
}
```

## src/ble_service.h
```c
#pragma once
// 防止檔案被重複包含

#include <stdint.h>  // 定義標準整數型態如 uint8_t、uint32_t 等

// 初始化 BLE (藍牙低功耗) 功能
// 主要負責設定藍牙模組、啟動服務等
void ble_init(void);

// 傳送通知封包 (Notification Packet) 給 BLE 連線的中央設備 (Central)
// data 是要傳送的資料指標，len 是資料長度
void ble_send_notify_packet(uint8_t *data, size_t len);

// 取得從 BLE 連線開始經過的時間（毫秒）
// 用來做事件的時間戳記
uint32_t ble_get_time_since_connected(void);
```
